/******************************************************************************
 * MicroOLED_Cube.ino
 * Поворот трехмерного куба на библиотеке MicroOLED Breakout
 * Автор Джим Линдблом @ SparkFun Electronics
 * Дата создания оригинала: 27 октября 2014 г.
 *
 * Этот скетч использует библиотеку MicroOLED для рисования трехмерной проекции
 * куба и поворачивает его по всем трем осям.
 *
 * Особенности среды разработки:
 * Arduino 1.0.5
 * Arduino Pro 3.3V
 * Micro OLED Breakout v1.0
 *
 * Распространяется как есть; гарантия не предоставляется.
 ******************************************************************************/
 
      #include <Wire.h>                        // Подключаем библиотеку для работы с шиной I2C (если дисплей подключется по этой шине)
//    #include <SPI.h>                         // Подключаем библиотеку для работы с шиной SPI (если дисплей подключется по этой шине)
      #include <SFE_MicroOLED.h>               // Подключаем библиотеку SFE_MicroOLED для работы с OLED дисплеем
                                               //
//    #define PIN_RESET 9                      // Определяем номер вывода к которому подключён вывод RST дисплея при подключении по шине SPI
//    #define PIN_DC    8                      // Определяем номер вывода к которому подключён вывод DC  дисплея при подключении по шине SPI
//    #define PIN_CS    10                     // Определяем номер вывода к которому подключён вывод CS  дисплея при подключении по шине SPI
                                               //
      #define PIN_RESET 255                    // Определяем номер вывода к которому подключён вывод RST дисплея при подключении по шине I2C (если у дисплея нет этого вывода, то присвиваем значение 255)
      #define DC_JUMPER 0                      // Определяем адрес дисплея на шине I2C: 0-0x3C / 1-0x3D
                                               //
//    MicroOLED oled(PIN_RESET,PIN_DC,PIN_CS); // Объявляем объект oled для работы с дисплеем по шине SPI, указывая ранее определённые выводы
      MicroOLED oled(PIN_RESET, DC_JUMPER);    // Объявляем объект oled для работы с дисплеем по шине I2C, указывая ранее определённые выводы и адрес дисплея
                                               //
int   SCREEN_WIDTH  = oled.getLCDWidth();      // Узнаём ширину дисплея в пикселях
int   SCREEN_HEIGHT = oled.getLCDHeight();     // Узнаём высоту дисплея в пикселях
void  drawCube(void);                          // Объявляем функцию поворота и прорисовки куба
float d     = 3;                               // Определяем множитель размера граней
float px [] = {-d, d, d,-d,-d, d, d,-d};       // Определяем массив направления граней
float py [] = {-d,-d, d, d,-d,-d, d, d};       // Определяем массив направления граней
float pz [] = {-d,-d,-d,-d, d, d, d, d};       // Определяем массив направления граней
float p2x[] = { 0, 0, 0, 0, 0, 0, 0, 0};       // Определяем массив вычисляемых углов губа
float p2y[] = { 0, 0, 0, 0, 0, 0, 0, 0};       // Определяем массив вычисляемых углов губа
float r  [] = { 0, 0, 0};                      // Определяем массив углов осей
                                               //
#define SHAPE_SIZE     600                     // Размер формы
#define ROTATION_SPEED 0                       // Скорость вращения куба (чем меньше число, тем быстрее вращение)
                                               //
void setup(){                                  //
     oled.begin();                             // Инициируем работу с дисплеем
     oled.clear(ALL);                          // Чистим графическую память дисплея (избавляемся от артефактов которые могли появиться при подаче питания)
     oled.display();                           // Выводим данные из буфера библиотеки на дисплей
     delay(1000);                              // Устанавливаем зажержку на 1 секунду
}                                              //
                                               //
void loop(){                                   //
     drawCube();                               // Вызываем функцию поворота и прорисовки куба
     delay(ROTATION_SPEED);                    // Устанавливаем зажержку на ROTATION_SPEED миллисекунд
}                                              //
                                               //
/***********************************************/
                                               //
//   Функция поворота и прорисовки куба:
void drawCube(){
//	 Добавляем градус к точкам на осях:
     r[0]=r[0]+PI/180.0; if(r[0]>=360.0*PI/180.0){r[0]=0;}
     r[1]=r[1]+PI/180.0; if(r[1]>=360.0*PI/180.0){r[1]=0;}
     r[2]=r[2]+PI/180.0; if(r[2]>=360.0*PI/180.0){r[2]=0;}
//	 Вычисляем координаты:
     for (int i=0;i<8;i++){
         float px2 = px[i];                       float py2 = cos(r[0])*py[i]-sin(r[0])*pz[i]; float pz2 = sin(r[0])*py[i]+cos(r[0])*pz[i];
         float px3 = cos(r[1])*px2+sin(r[1])*pz2; float py3 = py2;                             float pz3 = -sin(r[1])*px2+cos(r[1])*pz2;
         float ax  = cos(r[2])*px3-sin(r[2])*py3; float ay  = sin(r[2])*px3+cos(r[2])*py3;     float az  = pz3-150;
         p2x[i] = SCREEN_WIDTH /2+ax*SHAPE_SIZE/az;
         p2y[i] = SCREEN_HEIGHT/2+ay*SHAPE_SIZE/az;
     }
//	 Стираем предыдущие линии:
     oled.clear(PAGE);
//	 Прорисовываем новые линии:
     for (int i=0;i<3;i++){
         oled.line(p2x[i],p2y[i],p2x[i+1],p2y[i+1]); oled.line(p2x[i+4],p2y[i+4],p2x[i+5],p2y[i+5]); oled.line(p2x[i],p2y[i],p2x[i+4],p2y[i+4]);
     }   oled.line(p2x[3],p2y[3],p2x[0],p2y[0]);     oled.line(p2x[7],p2y[7],p2x[4],p2y[4]);         oled.line(p2x[3],p2y[3],p2x[7],p2y[7]);
//	 Выводим данные из буфера библиотеки на дисплей:
     oled.display();
}

